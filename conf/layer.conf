## conf/layer.conf
```bitbake
# We have a conf and classes directory, add to BBPATH
BBPATH .= ":${LAYERDIR}"

# We have a packages directory, add to BBFILES
BBFILES += "${LAYERDIR}/recipes-*/*/*.bb \
            ${LAYERDIR}/recipes-*/*/*.bbappend"

BBFILE_COLLECTIONS += "fsl-arm-vmx"
BBFILE_PATTERN_fsl-arm-vmx := "^${LAYERDIR}/"
BBFILE_PRIORITY_fsl-arm-vmx = "4"

LAYERDEPENDS_fsl-arm-vmx = "core freescale-layer"
```

## conf/machine/vmx25.conf
```bitbake
#@TYPE: Machine
#@NAME: Voipac VMX25 SoM Evaluation Kit
#@SOC: i.MX25
#@DESCRIPTION: Machine configuration for Voipac VMX25 SoM Evaluation Kit
#@MAINTAINER: support <support@voipac.com>

MACHINEOVERRIDES =. "mx25:"

include conf/machine/include/imx-base.inc
include conf/machine/include/tune-arm926ejs.inc

PREFERRED_PROVIDER_virtual/bootloader = "barebox-vmx"
PREFERRED_PROVIDER_barebox-vmx ?= "v2017.12.0"
PREFERRED_PROVIDER_virtual/kernel = "linux-vmx"
PREFERRED_VERSION_linux-vmx ?= "4.14"

IMAGE_BOOTLOADER = "barebox"

KERNEL_IMAGETYPE = "zImage"
KERNEL_DEVICETREE = "imx25-voipac-vmx25-254.dtb imx25-voipac-vmx25-255.dtb imx25-voipac-vmx25-264.dtb imx25-voipac-vmx25-265.dtb"

IMAGE_FSTYPES = "tar.xz ubifs ubi"

# ubifs support
MKUBIFS_ARGS = " -m 2KiB -e 126KiB -c 1912 -F"
UBINIZE_ARGS = " -m 2KiB -p 128KiB -s 512"
UBI_VOLNAME = "rootfs"

# wic support
WKS_FILES = "imx-barebox.wks"

SERIAL_CONSOLE = "115200 ttymxc0"

MACHINE_FEATURES = "usbgadget usbhost vfat alsa touchscreen"

# Overrides due use of non-FSL kernel
PREFERRED_VERSION_imx-test = "00.00.00"
MACHINE_GSTREAMER_PLUGIN_vmx25 = ""
MACHINE_FIRMWARE_append_mx25 = " firmware-imx-sdma-imx25"
MACHINE_EXTRA_RRECOMMENDS += "${MACHINE_FIRMWARE}"
```
